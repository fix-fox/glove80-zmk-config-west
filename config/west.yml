## config/west.yml
```yaml
manifest:
  remotes:
    - name: moergo-sc
      url-base: https://github.com/moergo-sc
  projects:
    - name: zmk
      remote: moergo-sc
      revision: main  # Tip: you can use a specific version tag here instead of 'main', e.g. 'v25.08'
      import: app/west.yml
  self:
    path: config
```
