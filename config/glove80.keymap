/*
 * Copyright (c) 2020 The ZMK Contributors
 *
 * SPDX-License-Identifier: MIT
 */

#define ZMK_POINTING_DEFAULT_MOVE_VAL 900  // default: 600
#define U_MOUSE_SLOW_MOVE_VAL 300

#include <behaviors.dtsi>
#include <dt-bindings/zmk/bt.h>
#include <dt-bindings/zmk/keys.h>
#include <dt-bindings/zmk/outputs.h>
#include <dt-bindings/zmk/pointing.h>
#include <dt-bindings/zmk/rgb.h>
#include "zmk-helpers/key-labels/glove80.h"
#include "zmk-helpers/helper.h"

// layers

#define DEFAULT_LAYER 0
#define MAGIC_LAYER 1
#define FACTORY_TEST_LAYER 2
#define HEBREW_LAYER 3
#define CURSOR_LAYER 4
#define NUMBERS_LAYER 5
#define SYMBOLS_LAYER 6
#define HEBREW_SYMBOLS_LAYER 7
#define SYSTEM_LAYER 8
#define MOUSE_LAYER 9
#define ORIGINAL_DEFAULT_LAYER 10
#define MACROS_LAYER 11
#define MOUSE_SLOW_LAYER 12
#define MOD_ACTIVE_LAYER 13
#define ENGLISH_ALPHA_LAYER 14

// Key position groups (labels from zmk-helpers/key-labels/glove80.h)
// Naming: [Side][Row][Position]  Side: L/R  Position: 0=inner .. 5=outer
// Rows: C=ceiling  N=number  T=top  M=middle(home)  B=bottom  F=floor  H=thumb
// Thumb keys: H3-H5 are the primary (inner) cluster, H0-H2 are secondary (outer)

#define KEYS_L  LC1 LC2 LC3 LC4 LC5  LN0 LN1 LN2 LN3 LN4 LN5  LT0 LT1 LT2 LT3 LT4 LT5  LM0 LM1 LM2 LM3 LM4 LM5  LB0 LB1 LB2 LB3 LB4 LB5  LF1 LF2 LF3 LF4 LF5
#define KEYS_R  RC1 RC2 RC3 RC4 RC5  RN0 RN1 RN2 RN3 RN4 RN5  RT0 RT1 RT2 RT3 RT4 RT5  RM0 RM1 RM2 RM3 RM4 RM5  RB0 RB1 RB2 RB3 RB4 RB5  RF1 RF2 RF3 RF4 RF5
#define THUMBS_L  LH0 LH1 LH2 LH3 LH4 LH5
#define THUMBS_R  RH0 RH1 RH2 RH3 RH4 RH5

// Generator: signal-layer modifier macro (press mod + activate MOD_ACTIVE_LAYER)
#define MAKE_MOD(NAME, MOD) \
    ZMK_MACRO(NAME, \
        wait-ms = <0>; \
        tap-ms = <0>; \
        bindings = \
            <&macro_press>, \
            <&mo MOD_ACTIVE_LAYER &kp MOD>, \
            <&macro_pause_for_release>, \
            <&macro_release>, \
            <&mo MOD_ACTIVE_LAYER &kp MOD>; \
    )

// Generator: home row mod hold-tap (left hand - triggers on right side + left thumbs)
#define MAKE_HRM_L(NAME, BIND) \
    ZMK_HOLD_TAP(NAME, \
        flavor = "balanced"; \
        require-prior-idle-ms = <150>; \
        tapping-term-ms = <280>; \
        quick-tap-ms = <175>; \
        bindings = <&BIND>, <&kp>; \
        hold-trigger-key-positions = <KEYS_R THUMBS_R LH5 LH2>; \
        hold-trigger-on-release; \
    )

// Generator: home row mod hold-tap (right hand - triggers on left side + right thumbs)
#define MAKE_HRM_R(NAME, BIND) \
    ZMK_HOLD_TAP(NAME, \
        flavor = "balanced"; \
        require-prior-idle-ms = <150>; \
        tapping-term-ms = <280>; \
        quick-tap-ms = <175>; \
        bindings = <&BIND>, <&kp>; \
        hold-trigger-key-positions = <KEYS_L THUMBS_L RH5 RH2>; \
        hold-trigger-on-release; \
    )

// Signal-layer modifier macros
MAKE_MOD(mod_lgui, LGUI)
MAKE_MOD(mod_lalt, LALT)
MAKE_MOD(mod_lctrl, LCTRL)
MAKE_MOD(mod_lshift, LSHIFT)
MAKE_MOD(mod_lgui_lalt, LG(LALT))
MAKE_MOD(mod_rgui, RGUI)
MAKE_MOD(mod_ralt, RALT)
MAKE_MOD(mod_rctrl, RCTRL)
MAKE_MOD(mod_rshift, RSHIFT)
MAKE_MOD(mod_rgui_ralt, RG(RALT))
MAKE_MOD(mod_lalt_lgui, LA(LGUI))

// Home row mod hold-taps
MAKE_HRM_L(hml_lgui, mod_lgui)
MAKE_HRM_L(hml_lalt, mod_lalt)
MAKE_HRM_L(hml_lctrl, mod_lctrl)
MAKE_HRM_L(hml_lshift, mod_lshift)
MAKE_HRM_L(hml_lgui_lalt, mod_lgui_lalt)
MAKE_HRM_R(hmr_rgui, mod_rgui)
MAKE_HRM_R(hmr_ralt, mod_ralt)
MAKE_HRM_R(hmr_rctrl, mod_rctrl)
MAKE_HRM_R(hmr_rshift, mod_rshift)
MAKE_HRM_R(hmr_rgui_ralt, mod_rgui_ralt)

// Thumb mod-tap with signal layer (no positional trigger)
ZMK_HOLD_TAP(mt_lalt_lgui, \
    flavor = "balanced"; \
    require-prior-idle-ms = <150>; \
    tapping-term-ms = <280>; \
    quick-tap-ms = <175>; \
    bindings = <&mod_lalt_lgui>, <&kp>; \
)

&mmv {
    x-input-code = <INPUT_REL_X>;
    y-input-code = <INPUT_REL_Y>;
    time-to-max-speed-ms = <300>;  // time-to-max-speed-ms = <300>;
    acceleration-exponent = <1>;
};

/ {
    behaviors {
        lt: layer_tap {
            compatible = "zmk,behavior-hold-tap";
            #binding-cells = <2>;
            bindings = <&mo>, <&kp>;

            flavor = "balanced";  // default "tap-preferred";
            tapping-term-ms = <280>;
            quick-tap-ms = <175>;
            require-prior-idle-ms = <150>;
            display-name = "Layer-Tap";
        };

        // sends backspace when tapped, delete when held with shift

        bspc_del: backspace_delete {
            compatible = "zmk,behavior-mod-morph";
            #binding-cells = <0>;
            bindings = <&kp BSPC>, <&kp DEL>;

            mods = <(MOD_LSFT|MOD_RSFT)>;
        };

        lt_bspc: layer_tap_backspace_delete {
            compatible = "zmk,behavior-hold-tap";
            #binding-cells = <2>;
            flavor = "balanced";
            tapping-term-ms = <200>;
            bindings = <&mo>, <&bspc_del>;

            quick-tap-ms = <175>;
            display-name = "Layer-Tap-Bspc-Del";
        };

        magic: magic_hold_tap {
            compatible = "zmk,behavior-hold-tap";
            label = "MAGIC_HOLD_TAP";
            #binding-cells = <2>;
            flavor = "tap-preferred";
            tapping-term-ms = <200>;
            bindings = <&mo>, <&rgb_ug_status_macro>;
        };

        // Custom mod-morph for Q key: q normally, ? with shift

        q_qmark: q_question_mark {
            compatible = "zmk,behavior-mod-morph";
            label = "Q_QMARK";
            #binding-cells = <0>;
            bindings = <&kp Q>, <&kp LS(FSLH)>;

            mods = <(MOD_LSFT|MOD_RSFT)>;
        };
    };

    macros {
        rgb_ug_status_macro: rgb_ug_status_macro_0 {
            label = "RGB_UG_STATUS";
            compatible = "zmk,behavior-macro";
            #binding-cells = <0>;
            bindings = <&rgb_ug RGB_STATUS>;
        };

        bt_0: bt_profile_macro_0 {
            label = "BT_0";
            compatible = "zmk,behavior-macro";
            #binding-cells = <0>;
            bindings = <&out OUT_BLE &bt BT_SEL 0>;
        };

        bt_1: bt_profile_macro_1 {
            label = "BT_1";
            compatible = "zmk,behavior-macro";
            #binding-cells = <0>;
            bindings = <&out OUT_BLE &bt BT_SEL 1>;
        };

        bt_2: bt_profile_macro_2 {
            label = "BT_2";
            compatible = "zmk,behavior-macro";
            #binding-cells = <0>;
            bindings = <&out OUT_BLE &bt BT_SEL 2>;
        };

        bt_3: bt_profile_macro_3 {
            label = "BT_3";
            compatible = "zmk,behavior-macro";
            #binding-cells = <0>;
            bindings = <&out OUT_BLE &bt BT_SEL 3>;
        };

        lang_toggle: lang_toggle {
            label = "LANG_TOGGLE";
            compatible = "zmk,behavior-macro";
            #binding-cells = <0>;
            bindings =
                <&macro_press>,
                <&kp LGUI>,
                <&macro_tap>,
                <&kp SPACE>,
                <&macro_release>,
                <&kp LGUI>,
                <&macro_tap>,
                <&tog HEBREW_LAYER>;
        };

        // Delete to beginning of line (Ctrl+U - "kill line backward")

        delete_to_bol: delete_to_bol {
            compatible = "zmk,behavior-macro";
            #binding-cells = <0>;
            bindings =
                <&macro_press>,
                <&kp LSHFT>,
                <&macro_tap>,
                <&kp HOME>,
                <&macro_release>,
                <&kp LSHFT>,
                <&macro_tap>,
                <&kp BSPC>;
        };

        // Delete to end of line (Ctrl+K - "kill line")

        delete_to_eol: delete_to_eol {
            compatible = "zmk,behavior-macro";
            #binding-cells = <0>;
            bindings =
                <&macro_press>,
                <&kp LSHFT>,
                <&macro_tap>,
                <&kp END>,
                <&macro_release>,
                <&kp LSHFT>,
                <&macro_tap>,
                <&kp BSPC>;
        };

        // Select current line

        select_line: select_line {
            compatible = "zmk,behavior-macro";
            #binding-cells = <0>;
            bindings =
                <&macro_tap>,
                <&kp HOME>,
                <&macro_press>,
                <&kp LSHFT>,
                <&macro_tap>,
                <&kp END>,
                <&macro_release>,
                <&kp LSHFT>;
        };

        // Opens a new browser tab (Ctrl+T) and taps "@gemini<TAB>"

        gemini_tab: gemini_tab {
            compatible = "zmk,behavior-macro";
            #binding-cells = <0>;
            bindings =
                <&macro_press>,
                <&kp LCTRL>,
                <&macro_tap>,
                <&kp T>,
                <&macro_release>,
                <&kp LCTRL>,
                <&macro_tap>,
                <&kp AT>,
                <&macro_tap>,
                <&kp G>,
                <&macro_tap>,
                <&kp E>,
                <&macro_tap>,
                <&kp M>,
                <&macro_tap>,
                <&kp I>,
                <&macro_tap>,
                <&kp N>,
                <&macro_tap>,
                <&kp I>,
                <&macro_tap>,
                <&kp TAB>;
        };

        flow_bookmark: flow_bookmark {
            compatible = "zmk,behavior-macro";
            #binding-cells = <0>;
            bindings =
                <&macro_press>,
                <&kp LCTRL>,
                <&macro_tap>,
                <&kp SPACE>,
                <&macro_release>,
                <&kp LCTRL>,
                <&macro_tap>,
                <&kp B &kp SPACE>;

            label = "FLOW_BOOKMARK";
        };

    };

    conditional_layers {
        compatible = "zmk,conditional-layers";

        hebrew_symbols {
            if-layers = <HEBREW_LAYER SYMBOLS_LAYER>;
            then-layer = <HEBREW_SYMBOLS_LAYER>;
        };

        // When Hebrew + modifier signal active, use English alpha for consistent shortcuts

        english_alpha_when_mod {
            if-layers = <HEBREW_LAYER MOD_ACTIVE_LAYER>;
            then-layer = <ENGLISH_ALPHA_LAYER>;
        };
    };

    combos {
        compatible = "zmk,combos";

        toggle_left_hand {
            bindings = <&tog CURSOR_LAYER>;
            key-positions = <LH5 LH2>;
        };

        mouse_toggle {
            bindings = <&tog MOUSE_LAYER>;
            key-positions = <RH2 RH5>;
        };

        caps_lock {
            bindings = <&kp CAPS>;
            key-positions = <LM0 RM0>;
            timeout-ms = <30>;
            require-prior-idle-ms = <300>;
        };

        caps_word {
            bindings = <&caps_word>;
            key-positions = <LM1 RM1>;
            timeout-ms = <30>;
            require-prior-idle-ms = <300>;
        };
    };

    keymap {
        compatible = "zmk,keymap";

        default_layer {
            bindings = <
&to DEFAULT_LAYER       &to ORIGINAL_DEFAULT_LAYER  &none  &none  &none                                                                                                                                            &none            &none           &none          &none          &kp LG(L)
&tog HEBREW_LAYER       &kp N1         &kp N2         &kp N3          &kp N4           &kp N5                                                                                                      &kp N6              &kp N7           &kp N8          &kp N9         &kp N0         &none
&none                   &kp Q          &kp W          &kp F           &kp P            &kp B                                                                                                       &kp J               &kp L            &kp U           &kp Y          &kp SEMI       &none
&none                   &hml_lgui 0 A  &hml_lalt 0 R  &hml_lctrl 0 S  &hml_lshift 0 T  &hml_lgui_lalt 0 G                                                                                          &hmr_rgui_ralt 0 M  &hmr_rshift 0 N  &hmr_rctrl 0 E  &hmr_ralt 0 I  &hmr_rgui 0 O  &none
&none                   &kp Z          &kp X          &kp C           &lt MACROS_LAYER D  &kp V            &lt NUMBERS_LAYER TAB  &lt SYSTEM_LAYER ESCAPE  &none    &none      &none                      &lt MOUSE_LAYER TAB  &kp K          &lt MACROS_LAYER H  &kp COMMA       &kp DOT        &kp FSLH       &none
&magic MAGIC_LAYER DEFAULT_LAYER  &kp GRAVE  &none  &kp SPACE  &kp ENTER                            &lt_bspc CURSOR_LAYER 0  &lt MOUSE_LAYER DEL  &none    &kp PSCRN  &mt_lalt_lgui 0 LC(SPACE)  &lt SYMBOLS_LAYER SPACE                      &kp ENTER        &tog MOUSE_LAYER  &none          &kp TILDE      &magic MAGIC_LAYER DEFAULT_LAYER
            >;
        };

        magic_layer {
            bindings = <
&trans       &none            &none            &none            &none                                                                                       &none  &none  &none  &bt BT_CLR  &bt BT_CLR_ALL
&none        &none            &none            &none            &none            &none                                                               &none  &none  &none  &none  &none       &none
&none        &rgb_ug RGB_SPI  &rgb_ug RGB_SAI  &rgb_ug RGB_HUI  &rgb_ug RGB_BRI  &rgb_ug RGB_TOG                                                     &none  &none  &none  &none  &none       &none
&bootloader  &rgb_ug RGB_SPD  &rgb_ug RGB_SAD  &rgb_ug RGB_HUD  &rgb_ug RGB_BRD  &rgb_ug RGB_EFF                                                     &none  &none  &none  &none  &none       &bootloader
&sys_reset   &none            &none            &none            &none            &none            &bt_2  &bt_3  &none           &none  &none  &none  &none  &none  &none  &none  &none       &sys_reset
&none        &none            &none            &none            &none                             &bt_0  &bt_1  &out OUT_USB    &none  &none  &none         &none  &none  &none  &none       &to FACTORY_TEST_LAYER
            >;
        };

        factory_test_layer {
            bindings = <
&to DEFAULT_LAYER  &kp N6  &kp N2  &kp N8  &kp N4                                                                    &kp N4  &kp N8  &kp N2  &kp N6  &kp N0
&kp N1  &kp N7  &kp N3  &kp N9  &kp N5  &kp N0                                                    &kp N0  &kp N5  &kp N9  &kp N3  &kp N7  &kp N1
&kp N2  &kp N8  &kp N4  &kp N0  &kp N6  &kp N1                                                    &kp N1  &kp N6  &kp N0  &kp N4  &kp N8  &kp N2
&kp N3  &kp N9  &kp N5  &kp N1  &kp N7  &kp N2                                                    &kp N2  &kp N7  &kp N1  &kp N5  &kp N9  &kp N3
&kp N4  &kp N0  &kp N6  &kp N2  &kp N8  &kp N3  &kp N4  &kp N5  &kp N6    &kp N6  &kp N5  &kp N4  &kp N3  &kp N8  &kp N2  &kp N6  &kp N0  &kp N4
&kp N5  &kp N1  &kp N7  &kp N3  &kp N9          &kp N7  &kp N8  &kp N9    &kp N9  &kp N8  &kp N7          &kp N9  &kp N3  &kp N7  &kp N1  &kp N5
            >;
        };

        hebrew_layer {
            // Hebrew base layer - identical to English QWERTY for Hebrew typing

            bindings = <
&trans  &trans         &trans         &trans          &trans                                                                                                     &trans           &trans          &trans         &trans            &trans
&trans  &trans         &trans         &trans          &trans           &trans                                                                &trans              &trans           &trans          &trans         &trans            &trans
&trans  &kp PERIOD     &kp COMMA      &kp E           &kp R            &kp T                                                                 &kp Y               &kp U            &kp I           &kp O          &kp P             &trans
&trans  &hml_lgui 0 A  &hml_lalt 0 S  &hml_lctrl 0 D  &hml_lshift 0 F  &hml_lgui_lalt 0 G                                                    &hmr_rgui_ralt 0 H  &hmr_rshift 0 J  &hmr_rctrl 0 K  &hmr_ralt 0 L  &hmr_rgui 0 SEMI  &kp APOS
&trans  &kp Z          &kp X          &kp C           &lt MACROS_LAYER V  &kp B            &trans  &trans  &trans    &trans  &trans  &trans  &kp N               &lt MACROS_LAYER M  &kp APOS        &kp SLASH      &q_qmark          &trans
&trans  &trans         &trans         &trans          &trans                               &trans  &trans  &trans    &mo DEFAULT_LAYER  &trans  &trans                      &trans           &trans          &trans         &trans            &trans
            >;
        };

        cursor_layer {
            bindings = <
&trans     &trans               &trans           &trans            &trans                                                                                          &trans         &trans      &trans     &trans  &trans
&trans     &trans               &trans           &trans            &trans                 &trans                                                           &trans  &trans         &trans      &trans     &trans  &trans
&trans     &kp LA(F4)           &kp LC(W)        &kp LC(F)         &kp LC(P)              &kp LC(B)                                                        &trans  &kp PG_UP      &kp UP      &kp PG_DN  &trans  &trans
&trans     &hml_lgui 0 LC(A)  &hml_lalt 0 LC(R)  &hml_lctrl 0 LC(S)  &hml_lshift 0 LC(T)  &kp LC(G)                                                        &trans  &kp LEFT       &kp DOWN    &kp RIGHT  &trans  &trans
&kp LC(Y)  &kp LC(Z)            &kp LC(X)        &kp LC(C)         &kp LC(D)              &kp LC(V)  &trans  &trans  &trans    &trans  &trans  &kp ESCAPE  &trans  &kp HOME       &kp ESCAPE  &kp END    &trans  &trans
&trans     &trans               &trans           &trans            &kp DEL                           &trans  &trans  &trans    &trans  &trans  &kp ENTER           &kp LA(LC(V))  &trans      &trans     &trans  &trans
            >;
        };

        numbers_layer {
            bindings = <
&trans  &trans  &trans        &trans     &trans                                                                            &trans  &trans  &trans  &trans   &trans
&trans  &trans  &trans        &trans     &trans          &trans                                                    &trans  &trans  &trans  &trans  &trans   &trans
&trans  &trans  &trans        &trans     &trans          &trans                                                    &trans  &kp N7  &kp N8  &kp N9  &kp F10  &trans
&trans  &trans  &kp LEFT_ALT  &kp LCTRL  &kp LEFT_SHIFT  &trans                                                    &trans  &kp N4  &kp N5  &kp N6  &kp F11  &trans
&trans  &trans  &trans        &trans     &trans          &trans  &trans  &trans  &trans    &trans  &trans  &trans  &trans  &kp N1  &kp N2  &kp N3  &kp F12  &trans
&trans  &trans  &trans        &trans     &trans                  &trans  &trans  &trans    &trans  &trans  &kp N0          &trans  &trans  &trans  &trans   &trans
            >;
        };

        symbols_layer {
            bindings = <
&trans  &trans         &trans          &trans     &trans                                                                                        &trans                 &trans             &trans           &trans            &trans
&trans  &trans         &trans          &trans     &trans                &trans                                                       &trans     &trans                 &trans             &trans           &trans            &trans
&trans  &trans         &trans          &kp COLON  &trans                &trans                                                       &kp CARET  &kp AMPS               &kp STAR           &kp PIPE         &trans            &trans
&trans  &kp BSLH       &kp EQUAL       &kp MINUS  &kp UNDER             &kp GRAVE                                                    &kp SQT    &kp DOUBLE_QUOTES      &hmr_rctrl 0 PLUS  &kp TILDE        &kp FSLH          &trans
&trans  &kp LESS_THAN  &kp LEFT_BRACE  &kp LBKT   &kp LEFT_PARENTHESIS  &kp SEMI   &trans  &trans  &trans    &trans  &trans  &trans  &kp COLON  &kp RIGHT_PARENTHESIS  &kp RBKT           &kp RIGHT_BRACE  &kp GREATER_THAN  &trans
&trans  &trans         &trans          &trans     &trans                           &none   &trans  &trans    &trans  &trans  &trans             &trans                 &trans             &trans           &trans            &trans
            >;
        };

        hebrew_symbols_layer {
            // Hebrew-specific symbol overrides
            // Most keys are transparent and fall through to SYMBOLS layer
            // Only define keys that need different positions for Hebrew

            bindings = <
&trans  &trans  &trans  &trans  &trans                                                                       &trans  &trans  &trans  &trans  &trans
&trans  &trans  &trans  &trans  &trans  &trans                                                       &trans  &trans  &trans  &trans  &trans  &trans
&trans  &trans  &trans  &trans  &trans  &trans                                                       &trans  &trans  &trans  &trans  &trans  &trans
&trans  &trans  &trans  &trans  &trans  &trans                                                       &kp W   &trans  &trans  &trans  &trans  &trans
&trans  &trans  &trans  &trans  &trans  &kp GRAVE  &trans  &trans  &trans    &trans  &trans  &trans  &trans  &trans  &trans  &trans  &trans  &trans
&trans  &trans  &trans  &trans  &trans             &trans  &trans  &trans    &trans  &trans  &trans          &trans  &trans  &trans  &trans  &trans
            >;
        };

        system_layer {
            bindings = <
&trans  &trans  &trans             &trans            &trans                                                                                                    &trans  &trans  &trans  &trans   &trans
&trans  &trans  &trans             &trans            &trans           &trans                                                                           &trans  &trans  &trans  &trans  &trans   &trans
&trans  &trans  &kp C_VOLUME_DOWN  &kp C_MUTE        &kp C_VOLUME_UP  &kp C_BRIGHTNESS_INC                                                             &trans  &kp F7  &kp F8  &kp F9  &kp F10  &trans
&trans  &trans  &kp C_PREV         &kp C_PLAY_PAUSE  &kp C_NEXT       &kp C_BRIGHTNESS_DEC                                                             &trans  &kp F4  &kp F5  &kp F6  &kp F11  &trans
&trans  &trans  &trans             &trans            &trans           &trans                &trans  &trans  &trans    &trans  &trans  &kp PRINTSCREEN  &trans  &kp F1  &kp F2  &kp F3  &kp F12  &trans
&trans  &trans  &trans             &trans            &trans                                 &trans  &trans  &trans    &trans  &trans  &kp LEFT_ALT             &trans  &trans  &trans  &trans   &trans
            >;
        };

        mouse_layer {
            bindings = <
&trans  &trans  &trans     &trans     &trans                                                                                  &trans          &trans          &trans           &trans  &trans
&trans  &trans  &trans     &trans     &trans          &trans                                                          &trans  &trans          &trans          &trans           &trans  &trans
&trans  &trans  &trans     &trans     &trans          &trans                                                          &trans  &msc SCRL_UP    &mmv MOVE_UP    &msc SCRL_DOWN   &trans  &trans
&trans  &trans  &trans     &kp LCTRL  &kp LEFT_SHIFT  &trans                                                          &trans  &mmv MOVE_LEFT  &mmv MOVE_DOWN  &mmv MOVE_RIGHT  &trans  &trans
&trans  &trans  &kp LC(X)  &kp LC(C)  &trans          &kp LC(V)  &trans  &trans  &trans    &trans  &trans  &trans     &trans  &msc SCRL_LEFT  &tog MOUSE_LAYER  &msc SCRL_RIGHT  &trans  &trans
&trans  &trans  &trans     &trans     &trans                     &mo MOUSE_SLOW_LAYER  &trans  &trans    &trans  &trans  &mkp LCLK          &mkp LCLK       &mkp MCLK       &mkp RCLK        &trans  &trans
            >;
        };

        original_default_layer {
            // Almost. Still can "escape" to the default layer with the top left key.
            // ---------------------------------------------------------------------------------------------------------------------------------
            // |  F1   |  F2 |  F3 |  F4  |  F5  |                                                               |  F6   |  F7   |  F8  |   F9  |  F10 |
            // |  =    |  1  |  2  |  3   |  4   |  5   |                                                 |  6   |   7   |   8   |  9   |   0   |   -  |
            // |  TAB  |  Q  |  W  |  E   |  R   |  T   |                                                 |  Y   |   U   |   I   |  O   |   P   |   \  |
            // |  ESC  |  A  |  S  |  D   |  F   |  G   |                                                 |  H   |   J   |   K   |  L   |   ;   |   '  |
            // |   `   |  Z  |  X  |  C   |  V   |  B   | LSHFT | LCTRL | LOWER | | LGUI  | RCTRL | RSHFT |  N   |   M   |   ,   |  .   |   /   | PGUP |
            // | MAGIC | HOME| END | LEFT | RIGHT|      | BSPC  | DEL   | LALT  | | RALT  | RET   | SPACE |      |  UP   | DOWN  |  [   |   ]   | PGDN |

            bindings = <
&to DEFAULT_LAYER  &kp F2  &kp F3  &kp F4  &kp F5                                                                                            &kp F6  &kp F7     &kp F8    &kp F9    &kp F10
&kp EQUAL   &kp N1    &kp N2   &kp N3    &kp N4     &kp N5                                                                         &kp N6  &kp N7  &kp N8     &kp N9    &kp N0    &kp MINUS
&kp TAB     &kp Q     &kp W    &kp E     &kp R      &kp T                                                                          &kp Y   &kp U   &kp I      &kp O     &kp P     &kp BSLH
&kp ESC     &kp A     &kp S    &kp D     &kp F      &kp G                                                                          &kp H   &kp J   &kp K      &kp L     &kp SEMI  &kp SQT
&kp GRAVE   &kp Z     &kp X    &kp C     &kp V      &kp B   &kp LSHFT  &kp LCTRL  &kp LEFT_GUI    &kp RMETA  &kp RCTRL  &kp RSHFT  &kp N   &kp M   &kp COMMA  &kp DOT   &kp FSLH  &kp PG_UP
&magic MAGIC_LAYER DEFAULT_LAYER  &kp HOME  &kp END  &kp LEFT  &kp RIGHT          &kp BSPC   &kp DEL    &kp LALT        &kp RALT   &kp RET    &kp SPACE          &kp UP  &kp DOWN   &kp LBKT  &kp RBKT  &kp PG_DN
            >;
        };

        macros_layer {
            bindings = <
&trans  &trans  &trans  &trans  &trans                                                                                                          &trans        &trans          &trans  &trans  &trans
&trans  &trans  &trans  &trans  &trans        &trans                                                                            &trans          &trans        &trans          &trans  &trans  &trans
&trans  &trans  &trans  &trans  &trans        &flow_bookmark                                                                    &trans          &select_line  &delete_to_bol  &trans  &trans  &trans
&trans  &trans  &trans  &trans  &trans        &gemini_tab                                                                       &trans          &trans        &kp COLON       &trans  &trans  &trans
&trans  &trans  &trans  &tog MOUSE_LAYER  &lang_toggle  &trans          &trans          &trans          &trans    &trans  &trans  &trans  &delete_to_eol  &lang_toggle  &tog MOUSE_LAYER  &trans  &trans  &trans
&trans  &trans  &trans  &trans  &trans                        &delete_to_bol  &delete_to_eol  &trans    &trans  &trans  &trans                  &trans        &trans          &trans  &trans  &trans
            >;
        };

        mouse_slow_layer {
            bindings = <
&trans  &trans  &trans  &trans  &trans                                                                    &trans                               &trans                               &trans                              &trans  &trans
&trans  &trans  &trans  &trans  &trans  &trans                                                    &trans  &trans                               &trans                               &trans                              &trans  &trans
&trans  &trans  &trans  &trans  &trans  &trans                                                    &trans  &trans                               &mmv MOVE_Y(-U_MOUSE_SLOW_MOVE_VAL)  &trans                              &trans  &trans
&trans  &trans  &trans  &trans  &trans  &trans                                                    &trans  &mmv MOVE_X(-U_MOUSE_SLOW_MOVE_VAL)  &mmv MOVE_Y(U_MOUSE_SLOW_MOVE_VAL)   &mmv MOVE_X(U_MOUSE_SLOW_MOVE_VAL)  &trans  &trans
&trans  &trans  &trans  &trans  &trans  &trans  &trans  &trans  &trans    &trans  &trans  &trans  &trans  &trans                               &trans                               &trans                              &trans  &trans
&trans  &trans  &trans  &trans  &trans          &trans  &trans  &trans    &trans  &trans  &trans          &trans                               &trans                               &trans                              &trans  &trans
            >;
        };

        mod_active_layer {
            // Signal layer activated by home row mod macros
            // Used with conditional layer to enable English alpha when Hebrew + modifier

            bindings = <
&trans  &trans  &trans  &trans  &trans                                                                    &trans  &trans  &trans  &trans  &trans
&trans  &trans  &trans  &trans  &trans  &trans                                                    &trans  &trans  &trans  &trans  &trans  &trans
&trans  &trans  &trans  &trans  &trans  &trans                                                    &trans  &trans  &trans  &trans  &trans  &trans
&trans  &trans  &trans  &trans  &trans  &trans                                                    &trans  &trans  &trans  &trans  &trans  &trans
&trans  &trans  &trans  &trans  &trans  &trans  &trans  &trans  &trans    &trans  &trans  &trans  &trans  &trans  &trans  &trans  &trans  &trans
&trans  &trans  &trans  &trans  &trans          &trans  &trans  &trans    &trans  &trans  &trans          &trans  &trans  &trans  &trans  &trans
            >;
        };

        english_alpha_layer {
            // Colemak alpha keys for consistent shortcuts when Hebrew + modifier active
            // Home row has mods to support multi-modifier combos (Ctrl+Shift+S, etc.)

            bindings = <
&trans  &trans         &trans         &trans          &trans                                                                                                     &trans           &trans          &trans         &trans         &trans
&trans  &trans         &trans         &trans          &trans           &trans                                                                &trans              &trans           &trans          &trans         &trans         &trans
&trans  &kp Q          &kp W          &kp F           &kp P            &kp B                                                                 &kp J               &kp L            &kp U           &kp Y          &trans         &trans
&trans  &hml_lgui 0 A  &hml_lalt 0 R  &hml_lctrl 0 S  &hml_lshift 0 T  &hml_lgui_lalt 0 G                                                    &hmr_rgui_ralt 0 M  &hmr_rshift 0 N  &hmr_rctrl 0 E  &hmr_ralt 0 I  &hmr_rgui 0 O  &trans
&trans  &kp Z          &kp X          &kp C           &kp D            &kp V               &trans  &trans  &trans    &trans  &trans  &trans  &kp K               &kp H            &trans          &trans         &trans         &trans
&trans  &trans         &trans         &trans          &trans                               &trans  &trans  &trans    &trans  &trans  &trans                      &trans           &trans          &trans         &trans         &trans
            >;
        };
    };
};
